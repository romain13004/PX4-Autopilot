## src/modules/romain_one/Kconfig
```kconfig
menuconfig MODULES_ROMAIN_ONE
	bool "romain_one"
	default y
	---help---
		Enable support for romain_one
```

## src/modules/romain_two/Kconfig
```kconfig
menuconfig MODULES_ROMAIN_TWO
	bool "romain_two"
	default y
	---help---
		Enable support for romain_two
```
